## LayerA/conf/layer.conf
```bitbake
# Put this layer directory at the head of the layer directory path.

BBPATH =. ":${LAYERDIR}"

# Put this layer's recipe pattern at the head of the recipe pattern list.

BBFILES =+ "${LAYERDIR}/*.bb"

# Add this layer's name to end of the list of layer names.

BBFILE_COLLECTIONS += "A"

# Set the priority for this layer.

BBFILE_PRIORITY_A = 50

# Set the directory pattern for this layer. This *appears* to enable BitBake to
# pick out the patterns in BBFILES that apply to this layer. This *seems* to be
# fundamental to enforcing the priority order.

BBFILE_PATTERN_A := "^${LAYERDIR}/"
```
